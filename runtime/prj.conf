## CMakeLists.txt
```
# SPDX-License-Identifier: Apache-2.0

cmake_minimum_required(VERSION 3.20.0)

if(DEFINED ENV{ZEPHYR_BASE} AND NOT "$ENV{ZEPHYR_BASE}" STREQUAL "")
  set(PYMETAL_ZEPHYR_BASE $ENV{ZEPHYR_BASE})
else()
  get_filename_component(PYMETAL_WORKSPACE_ROOT "${CMAKE_CURRENT_LIST_DIR}/.." ABSOLUTE)
  set(PYMETAL_ZEPHYR_BASE "${PYMETAL_WORKSPACE_ROOT}/external/zephyr")
endif()

if(NOT EXISTS "${PYMETAL_ZEPHYR_BASE}/share/zephyr-package/cmake/ZephyrConfig.cmake")
  message(FATAL_ERROR "Zephyr not found at ${PYMETAL_ZEPHYR_BASE}; run west update from packages/metal")
endif()

find_package(Zephyr REQUIRED HINTS ${PYMETAL_ZEPHYR_BASE})
project(runtime)

set(PYMETAL_ROOT ${CMAKE_CURRENT_LIST_DIR}/..)

zephyr_include_directories(${PYMETAL_ROOT}/include)

set(PYMETAL_SOURCES
  ${PYMETAL_ROOT}/src/pymergetic/metal/memory/layout.c
  ${PYMETAL_ROOT}/src/pymergetic/metal/memory/boot.c
  ${PYMETAL_ROOT}/src/pymergetic/metal/port/zephyr/kernel_static_port.c
  ${PYMETAL_ROOT}/src/pymergetic/metal/port/zephyr/kernel_heap_port.c
  ${PYMETAL_ROOT}/src/pymergetic/metal/port/zephyr/malloc_heap_port.c
)

target_sources(app PRIVATE src/main.c ${PYMETAL_SOURCES})
```

## Kconfig
```
mainmenu "Pymergetic Metal Runtime"

source "Kconfig.zephyr"
```

## prj.conf
```kconfig
# pymergetic-metal runtime — shared Kconfig; board conf overrides fake vs real metal malloc

# --- Picolibc (embedded C; never host EXTERNAL_LIBC) ---
CONFIG_PICOLIBC=y
# CONFIG_EXTERNAL_LIBC is not set
CONFIG_PICOLIBC_USE_MODULE=y

CONFIG_PICOLIBC_IO_FLOAT=y
CONFIG_PICOLIBC_LOCALE_INFO=y
CONFIG_PICOLIBC_LOCALE_EXTENDED_INFO=y
CONFIG_PICOLIBC_MULTIBYTE=y
CONFIG_PICOLIBC_ASSERT_VERBOSE=y

CONFIG_STDOUT_CONSOLE=y

# --- POSIX ---
CONFIG_POSIX_API=y

# --- memory ---
# k_malloc pool (inside kernel link; reduces malloc tail)
CONFIG_HEAP_MEM_POOL_SIZE=4194304
CONFIG_SYS_HEAP_RUNTIME_STATS=y
# Real metal: malloc/free -> dynamic SRAM tail (_end .. sram end)
CONFIG_COMMON_LIBC_MALLOC=y
CONFIG_COMMON_LIBC_MALLOC_ARENA_SIZE=-1
# Real metal: `prj.conf` tail + `runtime/boards/qemu_x86_64.conf` (KERNEL_VM_SIZE)

# --- C++ (minimal; vtables/new/delete only) ---
CONFIG_CPP=y
CONFIG_STD_CPP20=y
CONFIG_MINIMAL_LIBCPP=y
# CONFIG_GLIBCXX_LIBCPP is not set
# CONFIG_EXTERNAL_LIBCPP is not set
```

## boards/native_sim_native_64.conf
```kconfig
# Fake metal (native_sim): no MMU — picolibc cannot use an SRAM tail (ARENA_SIZE=-1
# touches unmapped host ELF bytes and segfaults). Use an in-link arena instead.
#
# Size must cover machine RAM minus the link footprint without this arena; regenerate
# after layout changes (≈ CONFIG_SRAM_SIZE * 1024 − link_bytes_without_arena).
CONFIG_COMMON_LIBC_MALLOC_ARENA_SIZE=92194176
```

## boards/pm_machine_ram.dtsi
```dts
#include <mem.h>

/* Machine RAM size (KiB). Both board overlays include this file. */
#define PM_MACHINE_RAM_KIB 98304
#define PM_MACHINE_RAM_BYTES DT_SIZE_K(PM_MACHINE_RAM_KIB)
```

## boards/qemu_x86_64.overlay
```dts
#include "pm_machine_ram.dtsi"

&dram0 {
	reg = <0x0 PM_MACHINE_RAM_BYTES>;
};
```

## src/main.c
```c
/*
 * Copyright (c) 2020 BayLibre, SAS
 *
 * SPDX-License-Identifier: Apache-2.0
 */

#include <zephyr/kernel.h>
#include <stdio.h>

int main(void)
{
	printf("Hello from pymergetic-metal on %s\n", CONFIG_BOARD_TARGET);
	printf("  pymergetic/metal: ok\n");
	return 0;
}
```
