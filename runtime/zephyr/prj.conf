## CMakeLists.txt
```
# SPDX-License-Identifier: Apache-2.0

cmake_minimum_required(VERSION 3.20.0)

if(DEFINED ENV{ZEPHYR_BASE} AND NOT "$ENV{ZEPHYR_BASE}" STREQUAL "")
  set(PYMETAL_ZEPHYR_BASE $ENV{ZEPHYR_BASE})
else()
  get_filename_component(PYMETAL_WORKSPACE_ROOT "${CMAKE_CURRENT_LIST_DIR}/../.." ABSOLUTE)
  set(PYMETAL_ZEPHYR_BASE "${PYMETAL_WORKSPACE_ROOT}/external/zephyr")
endif()

if(NOT EXISTS "${PYMETAL_ZEPHYR_BASE}/share/zephyr-package/cmake/ZephyrConfig.cmake")
  message(FATAL_ERROR "Zephyr not found at ${PYMETAL_ZEPHYR_BASE}; run west update from packages/metal")
endif()

find_package(Zephyr REQUIRED HINTS ${PYMETAL_ZEPHYR_BASE})
project(runtime)

set(PYMETAL_ROOT ${CMAKE_CURRENT_LIST_DIR}/../..)
set(TLSF_DIR ${PYMETAL_ROOT}/external/tlsf)

zephyr_include_directories(${PYMETAL_ROOT}/include)
zephyr_include_directories(${PYMETAL_ROOT}/src/pymergetic/port/headers)
zephyr_include_directories(${PYMETAL_ROOT}/src/pymergetic/metal/util)

zephyr_compile_definitions(PM_MAX_VIS=1)

set(PYMETAL_PORT_SOURCES
  ${PYMETAL_ROOT}/src/pymergetic/port/zephyr/plat.c
  ${PYMETAL_ROOT}/src/pymergetic/port/zephyr/kernel_static_port.c
  ${PYMETAL_ROOT}/src/pymergetic/port/zephyr/kernel_heap_port.c
  ${PYMETAL_ROOT}/src/pymergetic/port/zephyr/userspace_blob_port.c
)

set(PYMETAL_CORE_SOURCES
  ${PYMETAL_ROOT}/src/pymergetic/metal/memory/layout.c
  ${PYMETAL_ROOT}/src/pymergetic/metal/memory/arena.c
  ${PYMETAL_ROOT}/src/pymergetic/metal/memory/boot.c
  ${PYMETAL_ROOT}/src/pymergetic/metal/util/size.c
)

if(CONFIG_PM_MEMORY_BENCH)
  list(APPEND PYMETAL_CORE_SOURCES
    ${PYMETAL_ROOT}/src/pymergetic/metal/memory/bench.c
    ${PYMETAL_ROOT}/src/pymergetic/port/zephyr/bench_port.c
  )
endif()

if(CONFIG_PM_USERSPACE_BLOB)
  if(NOT EXISTS "${TLSF_DIR}/tlsf.h")
    message(FATAL_ERROR "tlsf not found at ${TLSF_DIR}; run west update from packages/metal")
  endif()

  list(APPEND PYMETAL_PORT_SOURCES
    ${PYMETAL_ROOT}/src/pymergetic/port/zephyr/userspace_blob.c
    ${PYMETAL_ROOT}/src/pymergetic/port/zephyr/mmap_port.c
    ${PYMETAL_ROOT}/src/pymergetic/port/zephyr/tlsf_malloc_port.c
    ${TLSF_DIR}/tlsf.c
  )

  if(CONFIG_PM_USERSPACE_BLOB_MEMTEST)
    list(APPEND PYMETAL_PORT_SOURCES
      ${PYMETAL_ROOT}/src/pymergetic/port/common/memtest.c
      ${PYMETAL_ROOT}/src/pymergetic/port/zephyr/memtest_parallel.c
    )
  endif()

  zephyr_include_directories(${TLSF_DIR})
  zephyr_compile_options(-fno-builtin-malloc)
  zephyr_ld_options(
    -Wl,--wrap=mmap
    -Wl,--wrap=munmap
  )
endif()

target_sources(app PRIVATE src/main.c ${PYMETAL_CORE_SOURCES} ${PYMETAL_PORT_SOURCES})

if(CONFIG_BUILD_OUTPUT_EFI)
  target_sources(app PRIVATE
    ${PYMETAL_ROOT}/src/pymergetic/port/zephyr/efi_ram.c
  )
  zephyr_include_directories(${PYMETAL_ZEPHYR_BASE}/arch/x86/zefi)
endif()
```

## Kconfig
```
mainmenu "Pymergetic Metal Runtime"

source "Kconfig.zephyr"

config PM_USERSPACE_BLOB
	bool "Userspace blob (TLSF pool for malloc and mmap)"
	default y
	help
	  Route libc malloc/free and wrapped mmap/munmap through one TLSF pool
	  over the userspace blob RAM window.
	  Disables Zephyr common libc sys_heap malloc (CONFIG_COMMON_LIBC_MALLOC).

config PM_USERSPACE_BLOB_SIZE
	int "Fixed userspace blob size in bytes (fake metal)"
	depends on PM_USERSPACE_BLOB
	default 0
	help
	  native_sim: fixed in-link TLSF pool backing (set in board conf).
	  0 on real metal: use dynamic SRAM tail after the kernel link map.

config PM_USERSPACE_BLOB_MEMTEST
	bool "Memtest userspace blob backing at registration"
	depends on PM_USERSPACE_BLOB
	default y
	help
	  Write and verify test patterns over the full blob backing before
	  TLSF takes ownership. Uses one worker per CPU (up to 4).

config PM_MEMORY_BENCH
	bool "Userspace allocator boot benchmark"
	depends on PM_USERSPACE_BLOB
	default y
	help
	  Run shared malloc/mmap micro-benchmarks after the memory layout report.
	  Compare with scripts/run-linux-bench.sh on host glibc.
```

## prj.conf
```kconfig
# pymergetic-metal runtime — shared Kconfig; board conf overrides fake vs real metal malloc

# --- Picolibc (embedded C; never host EXTERNAL_LIBC) ---
CONFIG_PICOLIBC=y
# CONFIG_EXTERNAL_LIBC is not set
CONFIG_PICOLIBC_USE_MODULE=y

CONFIG_PICOLIBC_IO_FLOAT=y
CONFIG_PICOLIBC_LOCALE_INFO=y
CONFIG_PICOLIBC_LOCALE_EXTENDED_INFO=y
CONFIG_PICOLIBC_MULTIBYTE=y
CONFIG_PICOLIBC_ASSERT_VERBOSE=y

CONFIG_STDOUT_CONSOLE=y

# --- POSIX ---
CONFIG_POSIX_API=y

# --- memory ---
# k_malloc pool (inside kernel link; reduces malloc tail)
CONFIG_HEAP_MEM_POOL_SIZE=4194304
CONFIG_SYS_HEAP_RUNTIME_STATS=y

# userspace blob: one TLSF pool for libc malloc and wrapped mmap/munmap
CONFIG_PM_USERSPACE_BLOB=y
CONFIG_PM_MEMORY_BENCH=y
# CONFIG_COMMON_LIBC_MALLOC is not set
# native_sim fixed blob: runtime/zephyr/boards/native_sim_native_64.conf
# Real metal: dynamic SRAM tail after _end

# --- C++ (minimal; vtables/new/delete only) ---
CONFIG_CPP=y
CONFIG_STD_CPP20=y
CONFIG_MINIMAL_LIBCPP=y
# CONFIG_GLIBCXX_LIBCPP is not set
# CONFIG_EXTERNAL_LIBCPP is not set
```

## boards/qemu_x86_64.conf
```kconfig
# Real metal (qemu_x86_64): x86 MMU virtual map cap (not machine RAM)
CONFIG_KERNEL_VM_SIZE=0x40000000

# Runtime RAM discovery via multiboot E820 (not DT pm_machine_ram.dtsi)
CONFIG_MULTIBOOT_MEMMAP=y
```

## src/main.c
```c
/*
 * Copyright (c) 2020 BayLibre, SAS
 *
 * SPDX-License-Identifier: Apache-2.0
 */

#include <pymergetic/metal/memory/boot.h>

int main(void)
{
	return pm_metal_memory_boot();
}
```
