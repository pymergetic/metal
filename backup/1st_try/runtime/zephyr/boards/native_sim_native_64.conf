## backup/1st_try/runtime/zephyr/boards/native_sim_native_64.conf
```kconfig
# Fake metal (native_sim): fixed userspace blob (TLSF pool for malloc + mmap).
#
# Size must cover machine RAM minus the link footprint; regenerate after layout
# changes (≈ CONFIG_SRAM_SIZE * 1024 − link_bytes_without_blob).
CONFIG_PM_USERSPACE_BLOB_SIZE=92194176
```

## backup/1st_try/runtime/zephyr/boards/qemu_x86_64_efi.conf
```kconfig
# qemu_x86_64 EFI payload (VirtualBox + QEMU UEFI via OVMF + FAT disk).
# Machine RAM probe: pymergetic port/efi_ram.c (vanilla Zephyr — no tree patches).
# CONFIG_SRAM_SIZE below is the kernel link map window only — not machine RAM.
# CONFIG_QEMU_UEFI_BOOT is intentionally off: it requires uefi-run at cmake time.
# Use scripts/pack-vbox-disk.sh output with OVMF or VirtualBox EFI instead.

CONFIG_BUILD_OUTPUT_EFI=y
# CONFIG_ACPI is not set
# CONFIG_PM_USERSPACE_BLOB_MEMTEST is not set
CONFIG_SRAM_SIZE=98304

CONFIG_KERNEL_VM_SIZE=0x40000000
# CONFIG_MULTIBOOT_MEMMAP is not set
```

## src/nuttx/Kconfig
```kconfig
#
# Pymergetic Metal runtime (WAMR host) for NuttX.
# See src/nuttx/README.md.
#

menuconfig PYMERGETIC_METAL
	bool "Pymergetic Metal WASM runtime"
	default n
	depends on LIBC
	---help---
		Long-lived Metal host: load/run wasm32-wasip1 mods via WAMR.
		First bring-up target is the NuttX sim board (hostdir rootfs).
		Build with NuttX CMake — see scripts/build nuttx sim.

if PYMERGETIC_METAL

config PYMERGETIC_METAL_PRIORITY
	int "Metal app priority"
	default 100

config PYMERGETIC_METAL_STACKSIZE
	int "Metal app stack size"
	default 65536

config PYMERGETIC_METAL_PROGNAME
	string "Metal program name"
	default "pm_metal"

endif # PYMERGETIC_METAL
```

## src/pymergetic/metal/Kconfig
```kconfig
menu "Pymergetic metal (OS core)"
config PM_METAL
	bool "Pymergetic metal runtime"
	default y
endmenu
```

## src/zephyr/Kconfig
```kconfig
# SPDX-License-Identifier: Apache-2.0

mainmenu "Pymergetic Metal (Zephyr)"

source "Kconfig.zephyr"

config PM_METAL_ARENA_ALIGN
	int "Metal arena alignment (bytes)"
	default 4096
	help
	  Page/alignment used when rounding arena_budget on targets without
	  CONFIG_MMU_PAGE_SIZE.

config PM_METAL_VERIFY_MODS
	bool "Embed and run Zephyr verify mods at boot"
	default n
	help
	  When enabled, main embeds the Zephyr verify wasm set (T0/T1, tmpfs,
	  populate, proc, multimod, process), stages them under the FAT root,
	  and runs pm_metal_app_run_scripted batches.

config PM_METAL_STATIC_POOL_BYTES
	int "Static Metal pool region (non-MMU targets)"
	default 16777216
	help
	  BSS-backed region carved into kheap + bytecode pools when CONFIG_MMU
	  is off (e.g. native_sim). Ignored when MMU mapping is used.
```

## src/zephyr/boards/native_sim_native_64.conf
```kconfig
# native_sim — fake metal: DT SRAM cap, fast local smoke
CONFIG_NATIVE_SIM_SLOWDOWN_TO_REAL_TIME=n
CONFIG_SRAM_SIZE=131072

# Loopback for WASI socket pair tests (t10–t28). Metal net/{dns,udp,http}
# uses host libc via port/host_*_adapt.c (no TAP / NSOS required).
CONFIG_NET_LOOPBACK=y
CONFIG_NET_L2_ETHERNET=n
CONFIG_NET_TEST=y
```

## src/zephyr/boards/qemu_x86_64.conf
```kconfig
# qemu_x86_64 — probe installed RAM via multiboot E820
CONFIG_KERNEL_VM_SIZE=0x40000000
CONFIG_MULTIBOOT_MEMMAP=y
# Link-time RAM region (KB) — must fit python.wasm + stdlib populate embeds
CONFIG_SRAM_SIZE=524288
# e1000 is in board DT (qemu_x86.dts); needs PCIE + user-net (SLIRP).
CONFIG_PCIE=y
CONFIG_ETH_E1000=y
CONFIG_NET_QEMU_USER=y
CONFIG_NET_QEMU_USER_EXTRA_ARGS="net=10.0.2.0/24,dhcpstart=10.0.2.15"
# Image + 128 MiB FAT + ~320 MiB WAMR arena for python guest
CONFIG_QEMU_EXTRA_FLAGS="-m 1G"
# mbedTLS SSL buffers + cert parse need a generous system heap on qemu.
CONFIG_HEAP_MEM_POOL_SIZE=8388608
# No entropy DT on this board — allow timer-based RNG for net/DNS smoke.
CONFIG_TEST_RANDOM_GENERATOR=y

# Keep loopback for WASI socket pair tests; e1000 for outbound Metal net.
# net_config AUTO_INIT picks the first iface (often loopback) — disable it and
# bind 10.0.2.15/gw onto ethernet from main (see main.c).
CONFIG_NET_LOOPBACK=y
CONFIG_NET_L2_ETHERNET=y
CONFIG_NET_DEFAULT_IF_ETHERNET=y
CONFIG_NET_TEST=n
CONFIG_NET_CONFIG_SETTINGS=y
CONFIG_NET_CONFIG_AUTO_INIT=n
CONFIG_NET_CONFIG_NEED_IPV4=y
CONFIG_NET_CONFIG_MY_IPV4_ADDR="10.0.2.15"
CONFIG_NET_CONFIG_MY_IPV4_GW="10.0.2.2"
CONFIG_NET_CONFIG_MY_IPV4_NETMASK="255.255.255.0"
CONFIG_DNS_SERVER_IP_ADDRESSES=y
CONFIG_DNS_SERVER1="10.0.2.3"
# Extra packet buffers / contexts for concurrent DNS + NTP + TLS on e1000.
CONFIG_NET_MAX_CONTEXTS=32
CONFIG_NET_MAX_CONN=32
CONFIG_NET_PKT_RX_COUNT=32
CONFIG_NET_PKT_TX_COUNT=32
CONFIG_NET_BUF_RX_COUNT=64
CONFIG_NET_BUF_TX_COUNT=64
```

## west-manifest/west.yml
```yaml
manifest:
  remotes:
    - name: zephyrproject
      url-base: https://github.com/zephyrproject-rtos
  projects:
    - name: zephyr
      repo-path: zephyr
      remote: zephyrproject
      revision: v4.4.0
      clone-depth: 1
      import:
        path-prefix: external
    - name: tlsf
      url: https://github.com/mattconte/tlsf
      revision: deff9ab509341f264addbd3c8ada533678591905
      path: external/tlsf
    - name: wasm-micro-runtime
      url: https://github.com/bytecodealliance/wasm-micro-runtime
      revision: WAMR-2.4.5
      path: external/wamr
    - name: lz4
      url: https://github.com/lz4/lz4
      revision: v1.10.0
      path: external/lz4
    - name: microtar
      url: https://github.com/rxi/microtar
      revision: 27076e1b9290e9c7842bb7890a54fcf172406c84
      path: external/microtar
```
