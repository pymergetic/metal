## CMakeLists.txt
```
# SPDX-License-Identifier: Apache-2.0

cmake_minimum_required(VERSION 3.20.0)

if(DEFINED ENV{ZEPHYR_BASE} AND NOT "$ENV{ZEPHYR_BASE}" STREQUAL "")
	set(PM_ZEPHYR_BASE $ENV{ZEPHYR_BASE})
else()
	get_filename_component(PM_METAL_ROOT "${CMAKE_CURRENT_LIST_DIR}/../.." ABSOLUTE)
	set(PM_ZEPHYR_BASE "${PM_METAL_ROOT}/external/zephyr")
endif()

if(NOT EXISTS "${PM_ZEPHYR_BASE}/share/zephyr-package/cmake/ZephyrConfig.cmake")
	message(FATAL_ERROR "Zephyr not found at ${PM_ZEPHYR_BASE}; run scripts/setup-west.sh")
endif()

find_package(Zephyr REQUIRED HINTS ${PM_ZEPHYR_BASE})
project(pm-zephyr-runtime)

get_filename_component(PM_METAL_ROOT "${CMAKE_CURRENT_LIST_DIR}/../.." ABSOLUTE)
set(PM_INCLUDE "${PM_METAL_ROOT}/include")
set(PM_SRC "${PM_METAL_ROOT}/src")
set(PM_COMMON_UTIL "${PM_METAL_ROOT}/host/common/pymergetic/metal/util")
set(PM_COMMON_RUNTIME "${PM_METAL_ROOT}/host/common/pymergetic/metal/runtime")
set(PM_UPPER
	${PM_SRC}/pymergetic/metal/sys/sys.c
	${PM_SRC}/pymergetic/metal/orchestrator/boot.c
)

if(DEFINED ENV{WAMR_ROOT_DIR} AND NOT "$ENV{WAMR_ROOT_DIR}" STREQUAL "")
	set(WAMR_ROOT_DIR $ENV{WAMR_ROOT_DIR})
else()
	set(WAMR_ROOT_DIR "${PM_METAL_ROOT}/external/wamr")
endif()

set(PM_WAMR_LIBC_UTIL "${WAMR_ROOT_DIR}/core/shared/platform/common/libc-util")

zephyr_include_directories(${PM_INCLUDE})
zephyr_include_directories(${CMAKE_CURRENT_LIST_DIR})
zephyr_include_directories("${PM_WAMR_LIBC_UTIL}")

set(WAMR_BUILD_PLATFORM "zephyr")
set(WAMR_BUILD_INTERP 1)
set(WAMR_BUILD_AOT 0)
set(WAMR_BUILD_LIBC_BUILTIN 1)
set(WAMR_BUILD_LIBC_WASI 1)
set(WAMR_BUILD_LIB_PTHREAD 0)
set(WAMR_BUILD_GLOBAL_HEAP_POOL 1)
set(WAMR_BUILD_GLOBAL_HEAP_SIZE 524288)

if(NOT EXISTS "${WAMR_ROOT_DIR}/build-scripts/runtime_lib.cmake")
	message(FATAL_ERROR "WAMR not found at ${WAMR_ROOT_DIR}; run scripts/setup-west.sh")
endif()

if(CONFIG_64BIT)
	set(WAMR_BUILD_TARGET "X86_64")
else()
	set(WAMR_BUILD_TARGET "X86_32")
endif()

include(${WAMR_ROOT_DIR}/build-scripts/runtime_lib.cmake)

set(PM_RUNTIME_SOURCES
	src/main.c
	${PM_COMMON_RUNTIME}/entry.c
	${PM_UPPER}
	pymergetic/metal/port/plat.c
	pymergetic/metal/sys/sys.c
	pymergetic/metal/sys/hostinfo.c
	pymergetic/metal/orchestrator/wasm_host.c
	pymergetic/wasi/zephyr_file.c
	pymergetic/wasi/zephyr_wasi_support.c
	${WAMR_RUNTIME_LIB_SOURCE}
	${WAMR_ROOT_DIR}/core/shared/platform/common/libc-util/libc_errno.c
	${PM_COMMON_UTIL}/bigtag.c
	${PM_COMMON_UTIL}/eightcc.c
	${PM_COMMON_UTIL}/endian.c
	${PM_COMMON_UTIL}/fourcc.c
	${PM_COMMON_UTIL}/version.c
	${PM_COMMON_UTIL}/versiontag.c
	${PM_COMMON_UTIL}/wiretag.c
)

if(CONFIG_PM_METAL_VERIFY_MOD_SMOKE)
	set(PM_MOD_SMOKE_EMBED "${CMAKE_CURRENT_LIST_DIR}/generated/mod_smoke_wasm.c")
	if(NOT EXISTS "${PM_MOD_SMOKE_EMBED}")
		message(FATAL_ERROR "Missing ${PM_MOD_SMOKE_EMBED}; run scripts/gen-mod-smoke-embed.sh")
	endif()
	list(APPEND PM_RUNTIME_SOURCES
		src/verify_mod_smoke.c
		${PM_MOD_SMOKE_EMBED}
	)
endif()

target_sources(app PRIVATE ${PM_RUNTIME_SOURCES})
target_compile_options(app PRIVATE -Wno-type-limits)
string(TIMESTAMP PM_METAL_BUILT_EPOCH "%s" UTC)
target_compile_definitions(app PRIVATE
	PM_METAL_BUILD_KERNEL=1
	PM_METAL_BUILT_EPOCH=${PM_METAL_BUILT_EPOCH}
	PM_METAL_ZEPHYR_WASI_FILE=1
)
target_compile_options(app PRIVATE
	"$<$<COMPILE_LANGUAGE:C>:-include${CMAKE_CURRENT_LIST_DIR}/pymergetic/wasi/zephyr_shim.h>"
)
target_include_directories(app PRIVATE "${PM_WAMR_LIBC_UTIL}")

if(DEFINED ENV{WASI_SDK_PATH} AND NOT "$ENV{WASI_SDK_PATH}" STREQUAL "")
	set(WASI_SDK_PATH $ENV{WASI_SDK_PATH})
elseif(EXISTS "${PM_METAL_ROOT}/.tools/wasi-sdk/share/wasi-sysroot/lib/wasm32-wasi/libm.a")
	set(WASI_SDK_PATH "${PM_METAL_ROOT}/.tools/wasi-sdk")
endif()

if(WASI_SDK_PATH)
	target_link_libraries(app PUBLIC
		"${WASI_SDK_PATH}/share/wasi-sysroot/lib/wasm32-wasi/libm.a"
		"${WASI_SDK_PATH}/share/wasi-sysroot/lib/wasm32-wasi/libdl.a")
endif()
```

## Kconfig
```
# SPDX-License-Identifier: Apache-2.0
# pymergetic-metal Zephyr engine — shared Kconfig

mainmenu "Pymergetic Metal Runtime (Zephyr)"

source "Kconfig.zephyr"

config PM_METAL_SYS_HANDOFF_VFS_ROOT
	string "Bootstrap handoff path (host and guest)"
	default "/sys/pm"
	help
	  Path where lower publishes bootstrap (…/bootstrap). Same path mods
	  open as PM_METAL_SYS_BOOTSTRAP_PATH when the host tree is WASI-preopened as /.

config PM_METAL_VERIFY_MOD_SMOKE
	bool "Stage and run mod-smoke.wasm after boot (verify)"
	default n
	help
	  Embed build/mods/mod-smoke.wasm, write it to the host VFS, and run it
	  via wasm_host after orchestrator boot. Used by verify-mod scripts.

config PM_METAL_ARENA_ALIGN
	int "Arena page alignment (bytes)"
	default 4096
	help
	  Page alignment for arena_budget and WAMR pool mapping on targets
	  without CONFIG_MMU_PAGE_SIZE (e.g. native_sim).
```

## prj.conf
```kconfig
# pymergetic-metal Zephyr engine — base prj.conf

CONFIG_PICOLIBC=y
CONFIG_PICOLIBC_USE_MODULE=y
CONFIG_PICOLIBC_IO_FLOAT=y

CONFIG_STDOUT_CONSOLE=y
CONFIG_CONSOLE=y
CONFIG_SERIAL=y
CONFIG_UART_CONSOLE=y

CONFIG_MAIN_STACK_SIZE=65536
CONFIG_HEAP_MEM_POOL_SIZE=1048576

CONFIG_POSIX_API=y
CONFIG_POSIX_TIMERS=y
CONFIG_POSIX_THREADS=y

# WAMR wasm_host + WASI (always on)
CONFIG_NETWORKING=y
CONFIG_NET_IPV4=y
CONFIG_NET_SOCKETS=y
CONFIG_ZVFS_OPEN_MAX=16

# VFS — bootstrap handoff at /sys/pm (boards/pm_ramdisk.overlay on all Zephyr targets)
CONFIG_FILE_SYSTEM=y
CONFIG_FILE_SYSTEM_MKFS=y
CONFIG_FAT_FILESYSTEM_ELM=y
CONFIG_FS_FATFS_FSTAB_AUTOMOUNT=y
CONFIG_FS_FATFS_LFN=y

CONFIG_DISK_ACCESS=y
CONFIG_DISK_DRIVERS=y
CONFIG_DISK_DRIVER_RAM=y

CONFIG_REQUIRES_FULL_LIBC=y

CONFIG_LOG=y
CONFIG_LOG_MODE_IMMEDIATE=y
CONFIG_PRINTK=y

CONFIG_STACK_SENTINEL=y

CONFIG_PM_METAL_ARENA_ALIGN=4096
```

## boards/qemu_x86_64.conf
```kconfig
# qemu_x86_64 — probe installed RAM via multiboot E820
CONFIG_KERNEL_VM_SIZE=0x40000000
CONFIG_MULTIBOOT_MEMMAP=y
```

## boards/verify_mod.conf
```kconfig
# Verify — stage embedded mod-smoke.wasm and run via wasm_host after boot
CONFIG_PM_METAL_VERIFY_MOD_SMOKE=y
```

## boards/pm_ramdisk.overlay
```dts
/ {
	fstab {
		compatible = "zephyr,fstab";

		pmfs: pmfs {
			compatible = "zephyr,fstab,fatfs";
			automount;
			disk-access;
			mount-point = "/";
		};
	};

	ramdisk0 {
		compatible = "zephyr,ram-disk";
		disk-name = "RAM";
		sector-size = <512>;
		sector-count = <2048>;
	};
};
```

## src/main.c
```c
/*
 * SPDX-License-Identifier: Apache-2.0
 * Zephyr runtime entry — delegates to shared host/common runtime boot.
 */
#include <pymergetic/metal/runtime/entry.h>
#include <pymergetic/metal/sys/sys.h>

#include <zephyr/autoconf.h>
#include <zephyr/sys/util.h>

#if IS_ENABLED(CONFIG_PM_METAL_VERIFY_MOD_SMOKE)
#include "verify_mod_smoke.h"
#endif

int main(void)
{
	pm_metal_runtime_config_t cfg = {
		.target = "zephyr",
		.handoff_vfs_root = PM_METAL_SYS_HANDOFF_VFS_ROOT,
	};
	int rc;

	rc = pm_metal_runtime_main(&cfg);
	if (rc != 0) {
		return 1;
	}

#if IS_ENABLED(CONFIG_PM_METAL_VERIFY_MOD_SMOKE)
	if (pm_metal_verify_mod_smoke_run() != 0) {
		return 1;
	}
#endif

	return 0;
}
```

## src/verify_mod_smoke.c
```c
/*
 * SPDX-License-Identifier: Apache-2.0
 * Verify — run embedded mod-smoke.wasm via WAMR.
 */
#include "verify_mod_smoke.h"

#include <pymergetic/metal/orchestrator/wasm_host.h>

#include <zephyr/sys/printk.h>

extern const unsigned char pm_mod_smoke_wasm[];
extern const unsigned int pm_mod_smoke_wasm_len;

int pm_metal_verify_mod_smoke_run(void)
{
	printk("verify_mod: running embedded mod-smoke (%u bytes)\n", pm_mod_smoke_wasm_len);
	return pm_metal_orchestrator_wasm_host_run_bytes(pm_mod_smoke_wasm, pm_mod_smoke_wasm_len);
}
```

## src/verify_mod_smoke.h
```c
/*
 * SPDX-License-Identifier: Apache-2.0
 * Verify helper — stage embedded mod-smoke.wasm and run via wasm_host.
 */
#ifndef PYMERGETIC_METAL_VERIFY_MOD_SMOKE_H_
#define PYMERGETIC_METAL_VERIFY_MOD_SMOKE_H_

int pm_metal_verify_mod_smoke_run(void);

#endif /* PYMERGETIC_METAL_VERIFY_MOD_SMOKE_H_ */
```
