## _old/config/Kconfig.build
```kconfig
menu "Build"

comment "Default targets for scripts/build when no argv is given"
comment "Argv (efi|bios|mod|all) overrides for that invocation only"

config PM_METAL_BUILD_EFI
	bool "efi (UEFI metal.efi)"
	default y
	help
	  Build freestanding UEFI Metal (metal.efi).

config PM_METAL_BUILD_BIOS
	bool "bios (Multiboot2 metal.elf)"
	default n
	help
	  Build freestanding Multiboot2 Metal (metal.elf).

config PM_METAL_BUILD_MOD
	bool "mod (guest wasm tests)"
	default n
	help
	  Build guest wasm test modules.

comment "BIOS arch (any combination; used when bios is enabled)"

config PM_METAL_BIOS_X86_64
	bool "bios x86_64"
	depends on PM_METAL_BUILD_BIOS
	default y
	help
	  Build Multiboot2 metal.elf for x86_64.
	  Override with: scripts/build bios x86_64

config PM_METAL_BIOS_I386
	bool "bios i386 (PXE-friendly)"
	depends on PM_METAL_BUILD_BIOS
	default n
	help
	  Build Multiboot2 metal.elf for i386.
	  Override with: scripts/build bios i386

comment "Follow-ups after a successful scripts/build (any combination)"
comment "Env PM_METAL_POST_ACTION=none skips all for one call"

config PM_METAL_POST_RUN
	bool "run (scripts/run)"
	depends on PM_METAL_BUILD_EFI || PM_METAL_BUILD_BIOS || PM_METAL_BUILD_MOD
	default n
	help
	  After build, invoke scripts/run (efi or bios when those were built).

config PM_METAL_POST_UPLOAD_EFI
	bool "upload-efi"
	depends on PM_METAL_BUILD_EFI
	default n
	help
	  After build, run scripts/upload-efi (needs efi target).

config PM_METAL_POST_UPLOAD_PXE
	bool "upload-pxe"
	depends on PM_METAL_BUILD_BIOS && (PM_METAL_BIOS_X86_64 || PM_METAL_BIOS_I386)
	default n
	help
	  After build, run scripts/upload-pxe (needs bios + at least one arch).

endmenu
```

## _old/config/metal/Kconfig
```kconfig
menu "pymergetic.metal"

source "metal/net/Kconfig"
source "metal/py/Kconfig"
source "metal/util/Kconfig"

endmenu
```

## _old/config/metal/net/Kconfig.asgi
```kconfig
menu "asgi"

config PM_METAL_ASGI_IO_MAX_MIB
	int "ASGI_IO_MAX (MiB)"
	default 4
	range 1 16
	help
	  ASGI server/conn iobuf (pm_metal_mem_map). Catalog: net.asgi.ASGI_IO_MAX.
	  confgen emits CONFIG_PM_METAL_ASGI_IO_MAX in bytes.

config PM_METAL_ASGI_MOUNT_MAX
	int "ASGI_MOUNT_MAX (count)"
	default 512
	range 4 2048
	help
	  Max path mounts per ASGI server.

config PM_METAL_ASGI_SRV_MAX
	int "ASGI_SRV_MAX (count)"
	default 16
	range 2 64
	help
	  Max concurrent ASGI listen servers.

config PM_METAL_ASGI_HDR_MAX_KIB
	int "ASGI_HDR_MAX (KiB)"
	default 256
	range 1 1024
	help
	  HTTP request header parse buffer.
	  confgen emits CONFIG_PM_METAL_ASGI_HDR_MAX in bytes.

config PM_METAL_ASGI_APP_SLOTS
	int "ASGI_APP_SLOTS (count)"
	default 128
	range 16 512
	help
	  ASGI app_h registry slots.

config PM_METAL_ASGI_PATH_MAX
	int "ASGI_PATH_MAX (bytes)"
	default 256
	range 64 1024
	help
	  Max request path / mount prefix length.

endmenu
```

## _old/config/metal/net/Kconfig.ip
```kconfig
menu "ip"

config PM_METAL_NET_PKG_SEED_HOST
	string "HTTP package seed host (optional)"
	default ""
	help
	  Optional last-resort host for guest/pkg HTTP seed when DHCP
	  next-server and the default gateway are unavailable. IPv4 literal
	  or hostname. Empty string means no compile-time host — seed then
	  requires next-server or gateway from the lease.

endmenu
```

## config/Kconfig.build
```kconfig
menu "Build"

comment "Firmware targets — build with: ./forge-cli build [efi|bios|all]"

config PM_METAL_BUILD_EFI
	bool "efi (UEFI metal.efi)"
	default y
	help
	  Build freestanding UEFI Metal (metal.efi) via ./forge-cli build efi.

config PM_METAL_BUILD_BIOS
	bool "bios (Multiboot2 metal.elf)"
	default y
	help
	  Build freestanding Multiboot2 Metal via ./forge-cli build bios.

comment "Follow-ups — run with: ./forge-cli run [efi|bios|all]"

config PM_METAL_POST_RUN
	bool "run (./forge-cli run after build)"
	depends on PM_METAL_BUILD_EFI || PM_METAL_BUILD_BIOS
	default n
	help
	  Hint only for now; invoke ./forge-cli run yourself after build.

endmenu
```

## config/defconfig
```kconfig
# Default exp2 config. menuconfig / oldconfig write config/.config.
CONFIG_PM_METAL_BUILD_EFI=y
CONFIG_PM_METAL_BUILD_BIOS=y
# CONFIG_PM_METAL_POST_RUN is not set
CONFIG_PM_METAL_FS_ROOT_SIZE_MIB=4
# CONFIG_PM_METAL_FS_SRC_MODE_NONE is not set
CONFIG_PM_METAL_FS_SRC_MODE_HUMAN=y
# CONFIG_PM_METAL_FS_SRC_MODE_ALL is not set
CONFIG_PM_METAL_FS_KERNEL_MODULE_ID="pymergetic.metal"
CONFIG_PM_METAL_FS_MOUNT_KERNEL_MODS=y
CONFIG_PM_METAL_FS_MOUNT_KERNEL_SRC=y
CONFIG_PM_METAL_FS_KERNEL_MODS_SEED=""
CONFIG_PM_METAL_LOG_BOOT_MOUNTS=y
CONFIG_PM_METAL_PY_ENABLE_REPL_SHELL=y
CONFIG_PM_METAL_GFX_SCANOUT_VIRTIO_GPU=y
CONFIG_PM_METAL_GFX_SCANOUT_BOCHS=y
CONFIG_PM_METAL_GFX_SCANOUT_RADEON=y
CONFIG_PM_METAL_GFX_SCANOUT_I915=y
CONFIG_PM_METAL_GFX_SCANOUT_GOP=y
CONFIG_PM_METAL_GFX_SCANOUT_LFB=y
CONFIG_PM_METAL_GFX_UI_BOOT_STRIPE=y
CONFIG_PM_METAL_TRUST_MODE_SOFT=y
```

## config/metal/net/Kconfig
```kconfig
menu "net"

source "metal/net/Kconfig.io"
source "metal/net/Kconfig.asgi"
source "metal/net/Kconfig.tls"

endmenu
```

## config/metal/net/Kconfig.tls
```kconfig
menu "tls"

config PM_METAL_TLS_WIRE_MAX_KIB
	int "PM_METAL_TLS_WIRE_MAX (KiB)"
	default 1024
	range 4 4096
	help
	  mbedTLS plaintext/ciphertext wire buf. Default matches IO_WIRE_MAX.
	  Catalog: net.tls.PM_METAL_TLS_WIRE_MAX.
	  confgen emits CONFIG_PM_METAL_TLS_WIRE_MAX in bytes.

endmenu
```

## config/metal/py/Kconfig
```kconfig
menu "py"

config PM_METAL_PY_BLOB_MIB
	int "PM_METAL_PY_BLOB (MiB)"
	default 16
	range 1 64
	help
	  Primary MicroPython heap blob. Catalog: py.PM_METAL_PY_BLOB_BYTES.
	  confgen emits CONFIG_PM_METAL_PY_BLOB_BYTES in bytes.

config PM_METAL_PY_ISOLATED_BLOB_KIB
	int "PM_METAL_PY_ISOLATED_BLOB (KiB)"
	default 256
	range 16 16384
	help
	  Isolated MicroPython session heap. Catalog: py.PM_METAL_PY_ISOLATED_BLOB_BYTES.
	  confgen emits CONFIG_PM_METAL_PY_ISOLATED_BLOB_BYTES in bytes.

endmenu
```

## config/metal/util/Kconfig.iface
```kconfig
menu "iface"

config PM_METAL_IFACE_EMBED_C_HEADERS
	bool "Embed C header packs (h@metal.guest, ...)"
	default y
	help
	  Bake lz4(ustar) packs via embed-iface.sh: h@metal.guest,
	  meta@metal.guest + meta@metal.guest.docs, and h@mod.t8_multimod_lib.
	  Also always bakes py@metal.stdlib (mandatory for MicroPython).
	  Gates the iface catalog; other Python packs depend on this.

config PM_METAL_IFACE_EMBED_C_IMPL
	bool "Embed full metal C/asm/h impl pack (JIT / rebuild)"
	default n
	depends on PM_METAL_IFACE_EMBED_C_HEADERS
	help
	  Bake c@metal.guest: all .c/.S/.s/.h under
	  src/pymergetic/metal, src/{efi,bios}/pymergetic/metal, and
	  include/pymergetic/metal. Skips *.inc.c (generated embeds). Off by default.

config PM_METAL_IFACE_EMBED_PYTHON_HEADERS
	bool "Embed Python stub packs (pyi@metal.guest)"
	default y
	depends on PM_METAL_IFACE_EMBED_C_HEADERS
	help
	  Bake pyi@metal.guest from typings/. Interface surface for
	  editors; not on MicroPython sys.path.

config PM_METAL_IFACE_EMBED_PYTHON_IMPL
	bool "Embed product Python pack (py@metal.guest)"
	default y
	depends on PM_METAL_IFACE_EMBED_C_HEADERS
	help
	  Bake py@metal.guest: httpd, api, templates, microdot, utemplate
	  in import layout (same as ESP /mods). On by default when the iface
	  catalog is enabled.

endmenu
```

## exp2/src/pymergetic/metal/boot/rootfs/.pm/Kconfig
```kconfig
menu "boot.rootfs"

config PM_METAL_LOG_BOOT_MOUNTS
	bool "Log each rootfs mount at bringup"
	default y
	help
	  Print one line per successful Stage-A / module mount.

endmenu
```

## port/boards/ARMV7_RV1106/metal.its
```
/dts-v1/;

/ {
	description = "FIT image with Linux kernel, FDT blob and resource";
	#address-cells = <1>;

	images {
		fdt {
			description = "rv1106";
			data = /incbin/("rv1106.dtb");
			type = "flat_dt";
			arch = "arm";
			compression = "none";
			load = <0xffffff00>;
			hash {
				algo = "sha256";
			};
		};
		kernel {
			description = "metal";
			data = /incbin/("metal.bin");
			type = "kernel";
			arch = "arm";
			os = "linux";
			compression = "none";
			load = <0xffffff01>;
			entry = <0xffffff01>;
			hash {
				algo = "sha256";
			};
		};
		resource {
			description = "resource";
			data = /incbin/("resource.img");
			type = "multi";
			arch = "arm";
			compression = "none";
			hash {
				algo = "sha256";
			};
		};
	};

	configurations {
		default = "conf";
		conf {
			description = "metal";
			rollback-index = <0x00>;
			fdt = "fdt";
			kernel = "kernel";
			multi = "resource";
		};
	};
};
```

## src/pymergetic/metal/dev/gfx/.pm/Kconfig
```kconfig
menu "gfx"

config PM_METAL_GFX_SCANOUT_VIRTIO_GPU
	bool "virtio_gpu scanout (QEMU virtio-gpu-pci)"
	default y
	help
	  Probe virtio-gpu RESOURCE_FLUSH present. QEMU opt-in device via
	  METAL_SCANOUT_VIRTIO_GPU=1 on forge run.

config PM_METAL_GFX_SCANOUT_BOCHS
	bool "bochs_flip scanout (QEMU stdvga DISPI)"
	default y
	help
	  Bochs/QEMU stdvga VBE virt_h page-flip. Default forge -vga std path.

config PM_METAL_GFX_SCANOUT_RADEON
	bool "radeon_rv370 scanout (ThinkPad T43 1002:5460)"
	default y
	help
	  Iron RV370 GART/CP + staging MMIO blit. Not exercised on QEMU
	  (unverified until real hardware).

config PM_METAL_GFX_SCANOUT_I915
	bool "i915_855gm scanout (ThinkPad T42 8086:3582 sample)"
	default y
	help
	  Sample Gen2 Intel GGTT + ring blit + DSPAADDR flip. Not exercised
	  on QEMU (unverified until real hardware).

config PM_METAL_GFX_SCANOUT_GOP
	bool "gop_blt scanout (pre-EBS EFI GOP Blt)"
	default y
	help
	  Pre-ExitBootServices EFI Graphics Output Blt present.

config PM_METAL_GFX_SCANOUT_LFB
	bool "lfb_copy scanout (chunked shadow->LFB memcpy)"
	default y
	help
	  Generic owned-framebuffer fallback (chunked memcpy).

config PM_METAL_GFX_UI_BOOT_STRIPE
	bool "Paint boot status stripe after gfx present"
	default y
	help
	  After detect/present, draw a bottom status line with the bound
	  scanout name (minimal UI consumer of the compositor). Real #ifdef
	  / rustc-cfg via gfx/.pm/build.rs reading build/autoconf.h.

endmenu
```

## src/pymergetic/metal/fs/.pm/Kconfig
```kconfig
menu "fs"

config PM_METAL_FS_ROOT_SIZE_MIB
	int "Root FAT size (MiB)"
	range 1 256
	default 4
	help
	  Size of the kernel Stage-A rootfs image mounted at "/".
	  Embedded in the firmware binary; seeded with etc/, tmp/, mods/, src/.
	  Keep small unless you need a large RW root.

choice
	prompt "Kernel source pack (/src/<id>)"
	default PM_METAL_FS_SRC_MODE_HUMAN
	help
	  What to embed under /src/<kernel module id>.
	  Built by: tools/forge build (forge img rootfs).

config PM_METAL_FS_SRC_MODE_NONE
	bool "none - do not embed/mount /src"
	help
	  Skip packing and mounting /src/<kernel id>.

config PM_METAL_FS_SRC_MODE_HUMAN
	bool "human only - forge originals (no generated faces)"
	help
	  Pack forge originals only. Skip files with the forge banner
	  "DO NOT HAND-EDIT THIS FILE."

config PM_METAL_FS_SRC_MODE_ALL
	bool "human + generated - include forge banner faces"
	help
	  Pack human sources plus forge-generated faces.

endchoice

config PM_METAL_FS_KERNEL_MODULE_ID
	string "Kernel module id (mount path segment)"
	default "pymergetic.metal"
	help
	  Dotted module id used for /mods/<id> and /src/<id>.

config PM_METAL_FS_MOUNT_KERNEL_MODS
	bool "Embed and mount /mods/<kernel id>"
	default y

config PM_METAL_FS_MOUNT_KERNEL_SRC
	bool "Embed and mount /src/<kernel id> (when mode != none)"
	default y
	depends on !PM_METAL_FS_SRC_MODE_NONE

config PM_METAL_FS_KERNEL_MODS_SEED
	string "Optional seed directory for kernel mods mtar (relative to exp2)"
	default ""
	depends on PM_METAL_FS_MOUNT_KERNEL_MODS
	help
	  If empty, an empty mtar is embedded.

endmenu
```

## src/pymergetic/metal/py/.pm/Kconfig
```kconfig
menu "py"

config PM_METAL_PY_ENABLE_REPL_SHELL
	bool "Boot straight into the Python REPL shell"
	default y
	help
	  Spawn the cooperative REPL boot shell (pm_metal_py_shell_start) as
	  an async task right after the boot tree prints, before the async
	  runner event loop takes over for good. Wired into
	  boot/platform/private/bringup.c behind
	  CONFIG_PM_METAL_PY_ENABLE_REPL_SHELL (real #ifdef, not a
	  documentation-only toggle).

	  Disable to boot straight to the idle async runner loop with no
	  interactive shell task -- ssh/httpd still serve, UART RX is just
	  never drained.

comment "Heap: py has no private arena -- pm_metal_py_alloc/free/realloc always go through the one shared Metal host heap (pymergetic.metal.mem), sized at bringup by the mem_map arena claim, not by this module. No py-specific heap budget exists here to configure."

comment "REPL buffers (1024B line, 256B feed ring, 64B/step drain) are compile-time Rust consts in py/_loop.rs and py/_shell.rs -- not Kconfig-driven yet (no Rust module reads autoconf.h today)."

comment "DYNAMIC_COMPILER: lexer/parse/compile stay linked in unconditionally today; no frozen-bytecode-only cutdown build exists yet to gate them out of."

endmenu
```

## src/pymergetic/metal/trust/.pm/Kconfig
```kconfig
menu "trust"

choice PM_METAL_TRUST_MODE
	prompt "Code trust policy for signed artifacts"
	default PM_METAL_TRUST_MODE_SOFT
	help
	  Policy for pm_metal_trust_accept_mods (and later kernel/pkg fetch):

	  off     -- never verify (dev)
	  soft    -- verify when a signature is present; unsigned OK
	  enforce -- signature required and must verify

config PM_METAL_TRUST_MODE_OFF
	bool "off (never verify)"

config PM_METAL_TRUST_MODE_SOFT
	bool "soft (verify when .sig present)"

config PM_METAL_TRUST_MODE_ENFORCE
	bool "enforce (signature required)"

endchoice

endmenu
```
