/** @file
  Slim WAMR runner for EFI Metal. (impl: efi|bios)
**/
#include <pymergetic/metal/guest/wasm/wasm.h>
#include <pymergetic/metal/guest/mod/mod.h> /* native_register + session_end */
#include <pymergetic/metal/guest/process/process.h>
#include <pymergetic/metal/dev/gfx/gfx.h>
#include <pymergetic/metal/shell/ui/ui.h>
#include <pymergetic/metal/shell/shell/shell.h>
#include <pymergetic/metal/runtime/async/async.h>
#include <runtime/mem/mem_internal.h>
#include <pymergetic/metal/dev/input/input.h>
#include <pymergetic/metal/shell/lifecycle/lifecycle.h>
#include <pymergetic/metal/shell/hwinfo/hwinfo.h>
#include <pymergetic/metal/fs/esp/esp.h>
#include <pymergetic/metal/fs/fs.h>
#include <pymergetic/metal/trust/trust.h>
#include <pymergetic/metal/dev/blk/blk.h>
#include <pymergetic/metal/dev/audio/audio.h>
#include <pymergetic/metal/dev/stream/stream.h>
#include <pymergetic/metal/dev/net/net.h>
#include <pymergetic/metal/dev/net/tls.h>
#include <pymergetic/metal/dev/net/ping.h>
#include <pymergetic/metal/dev/net/ntp.h>
#include <pymergetic/metal/dev/net/http.h>
#include <pymergetic/metal/dev/net/tftp.h>
#include <pymergetic/metal/guest/pkg/pkg.h>
#include <pymergetic/metal/dev/random/random.h>
#include <pymergetic/metal/util/arena.h>
#include <pymergetic/metal/util/log.h>
#include <pymergetic/metal/util/lz4.h>
#include <pymergetic/metal/util/tar.h>
#include <pymergetic/metal/util/crypto.h>
#include <pymergetic/metal/util/ascii.h>
#include <pymergetic/metal/util/size.h>
#include <pymergetic/metal/util/ip.h>
#include <pymergetic/metal/host/host.h>
#include <pymergetic/metal/py/py.h>
#include <pymergetic/metal/log/log.h>
#include <pymergetic/metal/runtime/mem/mem.h>
#include <runtime/time/time.h>

#include <stdint.h>
#include <stdio.h>
#include <string.h>

#include "wasm_export.h"

/* Generated by scripts/build.d/port/efi/embed-mods.sh */
#include "embed_mods.inc.c"

#ifndef PM_METAL_WASM_HEAP_SIZE
#define PM_METAL_WASM_HEAP_SIZE (96u * 1024u * 1024u)
#endif

#ifndef PM_METAL_WASM_STACK_SIZE
#define PM_METAL_WASM_STACK_SIZE (1024u * 1024u)
#endif

/*
 * Small WAMR module_malloc heap (async coro state only).
 * Guest malloc + ESP reads use wasi-libc memory.grow — keep this tiny
 * so the app heap insert does not starve the guest allocator.
 */
#ifndef PM_METAL_WASM_HEAP_BYTES
#define PM_METAL_WASM_HEAP_BYTES (256u * 1024u)
#endif

#ifndef PM_METAL_WASM_STARTUP_MS
#define PM_METAL_WASM_STARTUP_MS 100u
#endif

static int32_t              mReady;
static uint8_t             *mPool;
static uint32_t             mPoolSize;
static pm_metal_ui_handle_t mStdoutTab;
static pm_metal_stream_h    mStdoutStream;

/* Non-owning aliases of the live process mod image (mod slot owns). */
static wasm_module_t      mLiveModule;
static wasm_module_inst_t mLiveInst;
static wasm_exec_env_t    mLiveEnv;
static uint8_t           *mLiveCopy;
static char               mLiveName[64];

static void MetalWasmBindAll(wasm_module_inst_t inst);

static void strlcpy_trunc(char *dst, size_t dst_sz, const char *src)
{
  if (dst == NULL || dst_sz == 0) {
    return;
  }

  if (src == NULL) {
    dst[0] = '\0';
    return;
  }

  strncpy(dst, src, dst_sz - 1);
  dst[dst_sz - 1] = '\0';
}

pm_metal_ui_handle_t pm_metal_wasm_stdout_tab(void)
{
  return mStdoutTab;
}

void pm_metal_wasm_set_stdout_tab(pm_metal_ui_handle_t tab)
{
  pm_metal_stream_h old_in;
  pm_metal_stream_h in;

  mStdoutTab = tab;

  old_in = pm_metal_stdio_in();
  if (old_in != PM_METAL_STREAM_INVALID) {
    pm_metal_stream_close(old_in);
  }

  if (mStdoutStream != PM_METAL_STREAM_INVALID) {
    pm_metal_stream_close(mStdoutStream);
    mStdoutStream = PM_METAL_STREAM_INVALID;
  }

  if (tab == PM_METAL_UI_HANDLE_INVALID) {
    (void)pm_metal_stdio_attach(
      PM_METAL_STREAM_INVALID, PM_METAL_STREAM_INVALID, PM_METAL_STREAM_INVALID);
    return;
  }

  mStdoutStream = pm_metal_stream_open_ui_tab(tab);
  if (mStdoutStream == PM_METAL_STREAM_INVALID) {
    (void)pm_metal_stdio_attach(
      PM_METAL_STREAM_INVALID, PM_METAL_STREAM_INVALID, PM_METAL_STREAM_INVALID);
    return;
  }

  in = pm_metal_stream_open_uart();
  (void)pm_metal_stdio_attach(in, mStdoutStream, mStdoutStream);
}

int pm_metal_wasm_ready(void)
{
  return mReady;
}

static void MetalWasmUnbindAll(void)
{
  /*
	 * net/http/tftp/ntp/tls/ping/random derive wasm_module_inst_t from
	 * their own exec_env parameter (WAMR's standard native calling
	 * convention) — no bind_inst needed, see docs/COOP_MEMORY.md.
	 */
  pm_metal_fs_bind_inst(NULL);
  pm_metal_blk_bind_inst(NULL);
  pm_metal_audio_bind_inst(NULL);
  pm_metal_input_bind_inst(NULL);
  pm_metal_lifecycle_bind_inst(NULL);
  pm_metal_process_bind_inst(NULL);
  pm_metal_stream_bind_inst(NULL);
}

/*
 * mLive* are non-owning aliases of the process mod's image. Destroy happens
 * on mod unload (image_close), not when the process/call-in ends.
 */
static void MetalWasmLiveClear(void)
{
  MetalWasmUnbindAll();
  mLiveModule  = NULL;
  mLiveInst    = NULL;
  mLiveEnv     = NULL;
  mLiveCopy    = NULL;
  mLiveName[0] = '\0';
}

/* After nested open/call0, put WASI binds back on the live process mod. */
static void MetalWasmRebindLiveIfAny(void)
{
  if (mLiveInst != NULL) {
    MetalWasmBindAll(mLiveInst);
  }
}

void pm_metal_wasm_live_finish(void)
{
  pm_metal_process_id_t pid;
  char                  mod_name[64];
  const char           *nm;

  pid = pm_metal_process_current();
  if (pid == PM_METAL_PROCESS_ID_INVALID) {
    pid = pm_metal_process_pending();
  }

  mod_name[0] = '\0';
  if (mLiveName[0] != '\0') {
    strlcpy_trunc(mod_name, sizeof(mod_name), mLiveName);
  } else {
    nm = pm_metal_process_name(pid);
    if (nm != NULL) {
      strlcpy_trunc(mod_name, sizeof(mod_name), nm);
    }
  }

  pm_metal_lifecycle_blur();
  /* blur already unlocks pointer */
  if (pm_metal_async_session_active()) {
    pm_metal_async_session_end();
  }

  MetalWasmLiveClear();
  /*
   * Mod state must flip RUNNING -> READY before reap tears down any
   * owned fresh instance below — auto-unload (PM_METAL_MOD_FLAG_AUTO_UNLOAD)
   * checks mod state and would otherwise see a stale RUNNING and refuse.
   */
  if (mod_name[0] != '\0') {
    pm_metal_mod_on_session_end(mod_name);
  }

  if (pid != PM_METAL_PROCESS_ID_INVALID) {
    pm_metal_process_reap(pid);
  }

  pm_metal_ui_sync_input_focus();
}

static void MetalWasmLiveFinish(void)
{
  pm_metal_wasm_live_finish();
}

int pm_metal_wasm_init(void)
{
  RuntimeInitArgs init_args;

  if (mReady) {
    return 0;
  }

  pm_metal_pkg_init();

  mPoolSize = PM_METAL_WASM_HEAP_SIZE;
  mPool     = (uint8_t *)pm_metal_mem_alloc(mPoolSize, PM_METAL_MEM_HEAP, PM_METAL_MEM_ID_NONE);
  if (mPool == NULL) {
    pm_metal_log("metal-wasm: pool alloc failed");
    return -1;
  }

  memset(&init_args, 0, sizeof(init_args));
  init_args.mem_alloc_type                  = Alloc_With_Pool;
  init_args.mem_alloc_option.pool.heap_buf  = mPool;
  init_args.mem_alloc_option.pool.heap_size = mPoolSize;

  if (!wasm_runtime_full_init(&init_args)) {
    pm_metal_log("metal-wasm: wasm_runtime_full_init failed");
    pm_metal_mem_free(mPool);
    mPool = NULL;
    return -1;
  }

  if (pm_metal_gfx_native_register() != 0 || pm_metal_ui_native_register() != 0 ||
      pm_metal_shell_native_register() != 0 || pm_metal_async_native_register() != 0 ||
      pm_metal_mem_native_register() != 0 || pm_metal_input_native_register() != 0 ||
      pm_metal_lifecycle_native_register() != 0 || pm_metal_process_native_register() != 0 ||
      pm_metal_mod_native_register() != 0 || pm_metal_hwinfo_native_register() != 0 ||
      pm_metal_fs_native_register() != 0 || pm_metal_blk_native_register() != 0 ||
      pm_metal_audio_native_register() != 0 || pm_metal_stream_native_register() != 0 ||
      pm_metal_net_native_register() != 0 || pm_metal_net_tls_native_register() != 0 ||
      pm_metal_net_ping_native_register() != 0 || pm_metal_net_http_native_register() != 0 ||
      pm_metal_net_tftp_native_register() != 0 || pm_metal_net_ntp_native_register() != 0 ||
      pm_metal_random_native_register() != 0 || pm_metal_util_arena_native_register() != 0 ||
      pm_metal_util_log_native_register() != 0 || pm_metal_util_lz4_native_register() != 0 ||
      pm_metal_util_tar_native_register() != 0 || pm_metal_util_crypto_native_register() != 0 ||
      pm_metal_util_ascii_native_register() != 0 || pm_metal_util_size_native_register() != 0 ||
      pm_metal_util_ip_native_register() != 0 || pm_metal_host_native_register() != 0 ||
      pm_metal_py_native_register() != 0) {
    pm_metal_log("metal-wasm: native_register failed");
    wasm_runtime_destroy();
    pm_metal_mem_free(mPool);
    mPool = NULL;
    return -1;
  }

  mStdoutTab = PM_METAL_UI_HANDLE_INVALID;
  mReady     = 1;
  /* success — boot tree / callers log status */
  return 0;
}

void pm_metal_wasm_shutdown(void)
{
  if (!mReady) {
    return;
  }

  MetalWasmLiveFinish();
  wasm_runtime_destroy();
  if (mPool != NULL) {
    pm_metal_mem_free(mPool);
    mPool = NULL;
  }

  mReady = 0;
}

static int32_t MetalWasmModLookup(const char *name, const uint8_t **bytes, uint32_t *len)
{
  uint32_t i;
  char     arch_name[96];

  if (name == NULL || bytes == NULL || len == NULL) {
    return -1;
  }

  for (i = 0; i < g_pm_metal_embed_mod_count; i++) {
    if (strcmp(name, g_pm_metal_embed_mods[i].name) == 0) {
      *bytes = g_pm_metal_embed_mods[i].bytes;
      *len   = g_pm_metal_embed_mods[i].len;
      return 0;
    }
  }

  /* Bare name → host-arch AOT embed (async_aot → async_aot.i386 / .x86_64). */
  (void)snprintf(arch_name, sizeof(arch_name), "%s.%s", name, pm_metal_host_aot_arch());
  for (i = 0; i < g_pm_metal_embed_mod_count; i++) {
    if (strcmp(arch_name, g_pm_metal_embed_mods[i].name) == 0) {
      *bytes = g_pm_metal_embed_mods[i].bytes;
      *len   = g_pm_metal_embed_mods[i].len;
      return 0;
    }
  }

  return -1;
}

int pm_metal_wasm_fn_start_async(void                   *module,
                                 void                   *inst,
                                 void                   *exec_env,
                                 void                   *step_fn,
                                 pm_metal_async_handle_t root_coro,
                                 const char             *mod_name,
                                 uint8_t                *copy,
                                 uint32_t                pid)
{
  wasm_module_inst_t winst;
  wasm_exec_env_t    wenv;
  uint64_t           t0;
  uint64_t           deadline;
  uint32_t           life_surf;
  uint32_t           spins;
  int32_t            st;

  winst = (wasm_module_inst_t)inst;
  wenv  = (wasm_exec_env_t)exec_env;
  if (winst == NULL || wenv == NULL || step_fn == NULL ||
      root_coro == PM_METAL_ASYNC_HANDLE_INVALID) {
    return -1;
  }

  if (pm_metal_async_session_active()) {
    pm_metal_log("metal-wasm: session already active");
    return -1;
  }

  MetalWasmBindAll(winst);
  if (pm_metal_async_session_begin(winst, wenv, step_fn) != 0) {
    pm_metal_async_coro_close(root_coro);
    MetalWasmUnbindAll();
    return -1;
  }

  if (pm_metal_async_session_spawn_root_coro(root_coro) == PM_METAL_ASYNC_HANDLE_INVALID) {
    /* session_end reaps orphan guest coros (including root_coro). */
    pm_metal_async_session_end();
    MetalWasmUnbindAll();
    return -1;
  }

  /* Brief startup pump — short proofs may finish; long guests stay live. */
  t0       = pm_metal_time_mono_us();
  deadline = t0 + (uint64_t)PM_METAL_WASM_STARTUP_MS * 1000u;
  spins    = 0;
  while (!pm_metal_async_session_root_done()) {
    pm_metal_async_session_pump();
    if (pm_metal_time_mono_us() >= deadline || ++spins > 500000u) {
      break;
    }

    /* No Boot Services Stall — that adds 1 ms wake latency per idle loop. */
    __builtin_ia32_pause();
  }

  if (pm_metal_async_session_root_done()) {
    st = pm_metal_async_session_root_status();
    pm_metal_async_session_end();
    MetalWasmUnbindAll();
    return (st == PM_METAL_DONE) ? 0 : -1;
  }

  /*
	 * Startup busy-pumps session thousands of times/100ms — drop that
	 * window so the first metal-perf line is real shell pacing, not spin.
	 */
  pm_metal_async_perf_reset();

  /* Keep session + instance alive for shell_poll; mod owns the image. */
  mLiveModule = (wasm_module_t)module;
  mLiveInst   = winst;
  mLiveEnv    = wenv;
  mLiveCopy   = copy;
  strlcpy_trunc(mLiveName, sizeof(mLiveName), mod_name != NULL ? mod_name : "mod");
  if (pid != PM_METAL_PROCESS_ID_INVALID) {
    pm_metal_process_commit_live((pm_metal_process_id_t)pid);
    life_surf = pm_metal_process_surface((pm_metal_process_id_t)pid);
    if (life_surf == PM_METAL_GFX_SURFACE_INVALID) {
      life_surf = PM_METAL_GFX_SURFACE_DEFAULT;
    }
  } else {
    life_surf = PM_METAL_GFX_SURFACE_DEFAULT;
  }

  pm_metal_lifecycle_set(life_surf, PM_METAL_LIFE_FOCUSED | PM_METAL_LIFE_VISIBLE);
  /* Foreground tab + live session → guest keys (any mod). */
  pm_metal_ui_sync_input_focus();
  return 0;
}

static void MetalWasmBindAll(wasm_module_inst_t inst)
{
  pm_metal_fs_bind_inst(inst);
  pm_metal_blk_bind_inst(inst);
  pm_metal_audio_bind_inst(inst);
  pm_metal_input_bind_inst(inst);
  pm_metal_lifecycle_bind_inst(inst);
  pm_metal_process_bind_inst(inst);
  pm_metal_stream_bind_inst(inst);
}

void pm_metal_wasm_bind_inst(void *module_inst)
{
  MetalWasmBindAll((wasm_module_inst_t)module_inst);
}

static int32_t MetalWasmReadEspPackage(const char *name,
                                       const char *ext,
                                       uint8_t   **out_bytes,
                                       uint32_t   *out_len)
{
  uint8_t *esp_bytes;
  uint32_t esp_len;
  char     path[96];
  char     sig_path[112];
  uint8_t *sig;
  uint32_t sig_len;

  if (out_bytes == NULL || out_len == NULL) {
    return 1;
  }

  *out_bytes = NULL;
  *out_len   = 0;
  (void)snprintf(path, sizeof(path), "mods/apps/%s/%s.%s", name, name, ext);
  esp_bytes = NULL;
  esp_len   = 0;
  if (!pm_metal_esp_ready() || pm_metal_esp_read_file(path, &esp_bytes, &esp_len) != 0) {
    return 1;
  }

  if (pm_metal_trust_mode() != PM_METAL_TRUST_MODE_OFF) {
    (void)snprintf(sig_path, sizeof(sig_path), "mods/apps/%s/%s.%s.sig", name, name, ext);
    sig     = NULL;
    sig_len = 0;
    (void)pm_metal_esp_read_file(sig_path, &sig, &sig_len);
    if (pm_metal_trust_accept_mods(esp_bytes, esp_len, sig, sig_len) != 0) {
      pm_metal_logf("metal-wasm: trust fail %s", path);
      if (sig != NULL) {
        pm_metal_mem_free(sig);
      }

      pm_metal_mem_free(esp_bytes);
      return -1;
    }

    if (sig != NULL) {
      pm_metal_mem_free(sig);
    }
  }

  pm_metal_logf("metal-wasm: esp %s (%u bytes)", path, esp_len);
  *out_bytes = esp_bytes;
  *out_len   = esp_len;
  return 0;
}

int pm_metal_wasm_mod_fetch(const char     *name,
                            const uint8_t **bytes,
                            uint32_t       *len,
                            uint8_t       **esp_owned)
{
  int32_t rc;
  char    aot_ext[16];

  if (name == NULL || bytes == NULL || len == NULL || esp_owned == NULL) {
    return -1;
  }

  *bytes     = NULL;
  *len       = 0;
  *esp_owned = NULL;

  if (MetalWasmModLookup(name, bytes, len) == 0) {
    return 0;
  }

  (void)pm_metal_pkg_ensure(name);

  (void)snprintf(aot_ext, sizeof(aot_ext), "%s.aot", pm_metal_host_aot_arch());
  rc = MetalWasmReadEspPackage(name, aot_ext, esp_owned, len);
  if (rc == 0) {
    *bytes = *esp_owned;
    return 0;
  }

  if (rc < 0) {
    return -1;
  }

  rc = MetalWasmReadEspPackage(name, "wasm", esp_owned, len);
  if (rc == 0) {
    *bytes = *esp_owned;
    return 0;
  }

  return (rc < 0) ? -1 : 1;
}

/*
 * Shared tail of image_open/image_instantiate: instantiate an already
 * -loaded module, bind natives, spin up its exec_env. Caller owns
 * module lifetime (image_open: this image; image_instantiate: someone
 * else's registry slot) — this helper never loads/unloads/frees bytes.
 */
static int32_t MetalWasmInstantiateCommon(wasm_module_t              module,
                                          const char                *name,
                                          pm_metal_wasm_mod_image_t *out)
{
  wasm_module_inst_t inst;
  wasm_exec_env_t    exec_env;
  char               error_buf[128];

  error_buf[0] = '\0';
  inst         = wasm_runtime_instantiate(
    module, PM_METAL_WASM_STACK_SIZE, PM_METAL_WASM_HEAP_BYTES, error_buf, sizeof(error_buf));
  if (inst == NULL) {
    pm_metal_logf("metal-wasm: instantiate %s failed: %s", name != NULL ? name : "?", error_buf);
    return -1;
  }

  MetalWasmBindAll(inst);
  exec_env = wasm_runtime_create_exec_env(inst, PM_METAL_WASM_STACK_SIZE);
  if (exec_env == NULL) {
    wasm_runtime_deinstantiate(inst);
    MetalWasmRebindLiveIfAny();
    return -1;
  }

  out->module   = module;
  out->inst     = inst;
  out->exec_env = exec_env;
  strlcpy_trunc(out->name, sizeof(out->name), name != NULL ? name : "mod");
  MetalWasmRebindLiveIfAny();
  return 0;
}

int pm_metal_wasm_mod_image_open(const char                *name,
                                 const uint8_t             *bytes,
                                 uint32_t                   len,
                                 pm_metal_wasm_mod_image_t *out)
{
  wasm_module_t module;
  char          error_buf[128];
  uint8_t      *copy;
  const char   *argv[1];

  if (!mReady || bytes == NULL || len == 0 || out == NULL) {
    return -1;
  }

  memset(out, 0, sizeof(*out));
  copy = (uint8_t *)pm_metal_mem_alloc(len, PM_METAL_MEM_HEAP, PM_METAL_MEM_ID_NONE);
  if (copy == NULL) {
    return -1;
  }

  memcpy(copy, bytes, len);
  error_buf[0] = '\0';
  module       = wasm_runtime_load(copy, len, error_buf, sizeof(error_buf));
  if (module == NULL) {
    pm_metal_logf("metal-wasm: load %s failed: %s", name != NULL ? name : "?", error_buf);
    pm_metal_mem_free(copy);
    return -1;
  }

  argv[0] = (name != NULL) ? name : "mod";
  wasm_runtime_set_wasi_args(module, NULL, 0, NULL, 0, NULL, 0, (char **)argv, 1);

  if (MetalWasmInstantiateCommon(module, name, out) != 0) {
    wasm_runtime_unload(module);
    pm_metal_mem_free(copy);
    return -1;
  }

  out->copy = copy;
  pm_metal_logf("metal-wasm: mod image ready %s", out->name);
  return 0;
}

int pm_metal_wasm_mod_image_instantiate(void                      *module,
                                        const char                *name,
                                        pm_metal_wasm_mod_image_t *out)
{
  if (!mReady || module == NULL || out == NULL) {
    return -1;
  }

  memset(out, 0, sizeof(*out));
  if (MetalWasmInstantiateCommon((wasm_module_t)module, name, out) != 0) {
    return -1;
  }

  pm_metal_logf("metal-wasm: instance opened %s", out->name);
  return 0;
}

void pm_metal_wasm_mod_image_deinstantiate(pm_metal_wasm_mod_image_t *img)
{
  if (img == NULL) {
    return;
  }

  if (img->exec_env != NULL) {
    wasm_runtime_destroy_exec_env((wasm_exec_env_t)img->exec_env);
    img->exec_env = NULL;
  }

  if (img->inst != NULL) {
    wasm_runtime_deinstantiate((wasm_module_inst_t)img->inst);
    img->inst = NULL;
  }

  /* module/copy are non-owning aliases here — owned by the loader. */
  img->module  = NULL;
  img->name[0] = '\0';
}

void pm_metal_wasm_mod_image_close(pm_metal_wasm_mod_image_t *img)
{
  if (img == NULL) {
    return;
  }

  if (img->exec_env != NULL) {
    wasm_runtime_destroy_exec_env((wasm_exec_env_t)img->exec_env);
    img->exec_env = NULL;
  }

  if (img->inst != NULL) {
    wasm_runtime_deinstantiate((wasm_module_inst_t)img->inst);
    img->inst = NULL;
  }

  if (img->module != NULL) {
    wasm_runtime_unload((wasm_module_t)img->module);
    img->module = NULL;
  }

  if (img->copy != NULL) {
    pm_metal_mem_free(img->copy);
    img->copy = NULL;
  }

  img->name[0] = '\0';
}

void *pm_metal_wasm_mod_image_lookup(pm_metal_wasm_mod_image_t *img, const char *export_name)
{
  if (img == NULL || img->inst == NULL || export_name == NULL) {
    return NULL;
  }

  return (void *)wasm_runtime_lookup_function((wasm_module_inst_t)img->inst, export_name);
}

int pm_metal_wasm_mod_image_call0(pm_metal_wasm_mod_image_t *img,
                                  const char                *name,
                                  int32_t                   *result_out)
{
  wasm_function_inst_t fn;
  uint32_t             argv[1];
  const char          *exc;

  if (img == NULL || img->exec_env == NULL || img->inst == NULL || name == NULL) {
    return -1;
  }

  fn = wasm_runtime_lookup_function((wasm_module_inst_t)img->inst, name);
  if (fn == NULL) {
    return -1;
  }

  MetalWasmBindAll((wasm_module_inst_t)img->inst);
  argv[0] = 0;
  if (!wasm_runtime_call_wasm((wasm_exec_env_t)img->exec_env, fn, 0, argv)) {
    exc = wasm_runtime_get_exception((wasm_module_inst_t)img->inst);
    pm_metal_logf("metal-wasm: call %s.%s failed: %s", img->name, name, exc != NULL ? exc : "?");
    MetalWasmRebindLiveIfAny();
    return -1;
  }

  if (result_out != NULL) {
    *result_out = (int32_t)argv[0];
  }

  MetalWasmRebindLiveIfAny();
  return 0;
}
