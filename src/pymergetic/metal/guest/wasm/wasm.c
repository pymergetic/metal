/** @file
  Slim WAMR runner for EFI Metal. (impl: efi|bios)
**/
#include <pymergetic/metal/guest/wasm/wasm.h>
#include <pymergetic/metal/dev/gfx/gfx.h>
#include <pymergetic/metal/shell/ui/ui.h>
#include <pymergetic/metal/shell/shell/shell.h>
#include <pymergetic/metal/runtime/async/async.h>
#include <pymergetic/metal/dev/input/input.h>
#include <pymergetic/metal/shell/lifecycle/lifecycle.h>
#include <pymergetic/metal/shell/hwinfo/hwinfo.h>
#include <pymergetic/metal/fs/esp/esp.h>
#include <pymergetic/metal/fs/fs.h>
#include <pymergetic/metal/dev/blk/blk.h>
#include <pymergetic/metal/dev/audio/audio.h>
#include <pymergetic/metal/dev/stream/stream.h>
#include <pymergetic/metal/dev/net/net.h>
#include <pymergetic/metal/dev/net/tls.h>
#include <pymergetic/metal/dev/net/ping.h>
#include <pymergetic/metal/dev/net/http.h>
#include <pymergetic/metal/dev/random/random.h>
#include <pymergetic/metal/util/arena.h>
#include <pymergetic/metal/util/log.h>
#include <pymergetic/metal/util/lz4.h>
#include <pymergetic/metal/util/tar.h>
#include <pymergetic/metal/util/crypto.h>
#include <pymergetic/metal/util/ascii.h>
#include <pymergetic/metal/util/size.h>
#include <pymergetic/metal/log/log.h>
#include <runtime/mem/mem.h>
#include <runtime/time/time.h>

#include <Uefi.h>
#include <Library/BaseLib.h>
#include <Library/BaseMemoryLib.h>
#include <Library/CpuLib.h>
#include <Library/PrintLib.h>
#include <Library/UefiLib.h>
#include <Library/UefiBootServicesTableLib.h>

#include "wasm_export.h"

/* Generated by scripts/build.d/port/efi/embed-mods.sh */
#include "embed_mods.inc.c"

#ifndef PM_METAL_WASM_HEAP_SIZE
#define PM_METAL_WASM_HEAP_SIZE  (96u * 1024u * 1024u)
#endif

#ifndef PM_METAL_WASM_STACK_SIZE
#define PM_METAL_WASM_STACK_SIZE  (1024u * 1024u)
#endif

/*
 * Small WAMR module_malloc heap (async coro state only).
 * Guest malloc + ESP reads use wasi-libc memory.grow — keep this tiny
 * so the app heap insert does not starve the guest allocator.
 */
#ifndef PM_METAL_WASM_HEAP_BYTES
#define PM_METAL_WASM_HEAP_BYTES  (256u * 1024u)
#endif

#ifndef PM_METAL_WASM_STARTUP_MS
#define PM_METAL_WASM_STARTUP_MS  100u
#endif

STATIC INT32                 mReady;
STATIC UINT8                *mPool;
STATIC UINT32                mPoolSize;
STATIC pm_metal_ui_handle_t  mStdoutTab;
STATIC pm_metal_stream_h     mStdoutStream;

/* Long-lived async session owns these until finish. */
STATIC wasm_module_t         mLiveModule;
STATIC wasm_module_inst_t    mLiveInst;
STATIC wasm_exec_env_t       mLiveEnv;
STATIC UINT8                *mLiveCopy;
STATIC CHAR8                 mLiveName[64];

pm_metal_ui_handle_t
pm_metal_wasm_stdout_tab (
  VOID
  )
{
  return mStdoutTab;
}

void
pm_metal_wasm_set_stdout_tab (
  pm_metal_ui_handle_t  tab
  )
{
  mStdoutTab = tab;

  {
    pm_metal_stream_h  old_in;

    old_in = pm_metal_stdio_in ();
    if (old_in != PM_METAL_STREAM_INVALID) {
      pm_metal_stream_close (old_in);
    }
  }

  if (mStdoutStream != PM_METAL_STREAM_INVALID) {
    pm_metal_stream_close (mStdoutStream);
    mStdoutStream = PM_METAL_STREAM_INVALID;
  }

  if (tab == PM_METAL_UI_HANDLE_INVALID) {
    (VOID)pm_metal_stdio_attach (
            PM_METAL_STREAM_INVALID,
            PM_METAL_STREAM_INVALID,
            PM_METAL_STREAM_INVALID
            );
    return;
  }

  mStdoutStream = pm_metal_stream_open_ui_tab (tab);
  if (mStdoutStream == PM_METAL_STREAM_INVALID) {
    (VOID)pm_metal_stdio_attach (
            PM_METAL_STREAM_INVALID,
            PM_METAL_STREAM_INVALID,
            PM_METAL_STREAM_INVALID
            );
    return;
  }

  {
    pm_metal_stream_h  in;

    in = pm_metal_stream_open_uart ();
    (VOID)pm_metal_stdio_attach (in, mStdoutStream, mStdoutStream);
  }
}

int
pm_metal_wasm_ready (
  VOID
  )
{
  return mReady;
}

STATIC
VOID
MetalWasmLiveClear (
  VOID
  )
{
  pm_metal_fs_bind_inst (NULL);
  pm_metal_blk_bind_inst (NULL);
  pm_metal_audio_bind_inst (NULL);
  pm_metal_input_bind_inst (NULL);
  pm_metal_lifecycle_bind_inst (NULL);
  pm_metal_stream_bind_inst (NULL);
  pm_metal_net_bind_inst (NULL);
  pm_metal_net_tls_bind_inst (NULL);
  pm_metal_net_ping_bind_inst (NULL);
  pm_metal_net_http_bind_inst (NULL);
  pm_metal_random_bind_inst (NULL);

  if (mLiveEnv != NULL) {
    wasm_runtime_destroy_exec_env (mLiveEnv);
    mLiveEnv = NULL;
  }

  if (mLiveInst != NULL) {
    wasm_runtime_deinstantiate (mLiveInst);
    mLiveInst = NULL;
  }

  if (mLiveModule != NULL) {
    wasm_runtime_unload (mLiveModule);
    mLiveModule = NULL;
  }

  if (mLiveCopy != NULL) {
    pm_metal_mem_free (mLiveCopy);
    mLiveCopy = NULL;
  }

  mLiveName[0] = '\0';
}

STATIC
VOID
MetalWasmLiveFinish (
  VOID
  )
{
  pm_metal_lifecycle_blur ();
  /* blur already unlocks pointer */
  if (pm_metal_async_session_active ()) {
    pm_metal_async_session_end ();
  }

  MetalWasmLiveClear ();
  pm_metal_ui_sync_input_focus ();
}

int
pm_metal_wasm_init (
  VOID
  )
{
  RuntimeInitArgs  init_args;

  if (mReady) {
    return 0;
  }

  mPoolSize = PM_METAL_WASM_HEAP_SIZE;
  mPool     = (UINT8 *)pm_metal_mem_alloc (
                         mPoolSize,
                         PM_METAL_MEM_HEAP,
                         PM_METAL_MEM_ID_NONE
                         );
  if (mPool == NULL) {
    pm_metal_log ("metal-wasm: pool alloc failed");
    return -1;
  }

  ZeroMem (&init_args, sizeof (init_args));
  init_args.mem_alloc_type             = Alloc_With_Pool;
  init_args.mem_alloc_option.pool.heap_buf  = mPool;
  init_args.mem_alloc_option.pool.heap_size = mPoolSize;

  if (!wasm_runtime_full_init (&init_args)) {
    pm_metal_log ("metal-wasm: wasm_runtime_full_init failed");
    pm_metal_mem_free (mPool);
    mPool = NULL;
    return -1;
  }

  if (pm_metal_gfx_native_register () != 0
      || pm_metal_ui_native_register () != 0
      || pm_metal_shell_native_register () != 0
      || pm_metal_async_native_register () != 0
      || pm_metal_input_native_register () != 0
      || pm_metal_lifecycle_native_register () != 0
      || pm_metal_hwinfo_native_register () != 0
      || pm_metal_fs_native_register () != 0
      || pm_metal_blk_native_register () != 0
      || pm_metal_audio_native_register () != 0
      || pm_metal_stream_native_register () != 0
      || pm_metal_net_native_register () != 0
      || pm_metal_net_tls_native_register () != 0
      || pm_metal_net_ping_native_register () != 0
      || pm_metal_net_http_native_register () != 0
      || pm_metal_random_native_register () != 0
      || pm_metal_util_arena_native_register () != 0
      || pm_metal_util_log_native_register () != 0
      || pm_metal_util_lz4_native_register () != 0
      || pm_metal_util_tar_native_register () != 0
      || pm_metal_util_crypto_native_register () != 0
      || pm_metal_util_ascii_native_register () != 0
      || pm_metal_util_size_native_register () != 0)
  {
    pm_metal_log ("metal-wasm: native_register failed");
    wasm_runtime_destroy ();
    pm_metal_mem_free (mPool);
    mPool = NULL;
    return -1;
  }

  mStdoutTab = PM_METAL_UI_HANDLE_INVALID;
  mReady     = 1;
  /* success — boot tree / callers log status */
  return 0;
}

void
pm_metal_wasm_shutdown (
  VOID
  )
{
  if (!mReady) {
    return;
  }

  MetalWasmLiveFinish ();
  wasm_runtime_destroy ();
  if (mPool != NULL) {
    pm_metal_mem_free (mPool);
    mPool = NULL;
  }

  mReady = 0;
}

int
pm_metal_wasm_mod_lookup (
  CONST CHAR8     *name,
  CONST UINT8    **bytes,
  UINT32          *len
  )
{
  UINT32  i;

  if (name == NULL || bytes == NULL || len == NULL) {
    return -1;
  }

  for (i = 0; i < g_pm_metal_embed_mod_count; i++) {
    if (AsciiStrCmp (name, g_pm_metal_embed_mods[i].name) == 0) {
      *bytes = g_pm_metal_embed_mods[i].bytes;
      *len   = g_pm_metal_embed_mods[i].len;
      return 0;
    }
  }

  return -1;
}

STATIC
INT32
MetalWasmRunAsyncLive (
  CONST CHAR8           *name,
  wasm_module_t          module,
  wasm_module_inst_t     inst,
  wasm_exec_env_t        exec_env,
  wasm_function_inst_t   step_fn
  )
{
  UINT64  t0;
  UINT64  deadline;

  if (pm_metal_async_session_begin (inst, exec_env, step_fn) != 0) {
    return -1;
  }

  if (pm_metal_async_session_spawn_root () == PM_METAL_ASYNC_HANDLE_INVALID) {
    pm_metal_async_session_end ();
    return -1;
  }

  /* Brief startup pump — short proofs may finish; long guests stay live. */
  t0       = pm_metal_time_mono_us ();
  deadline = t0 + (UINT64)PM_METAL_WASM_STARTUP_MS * 1000u;
  {
    UINT32  spins;

    spins = 0;
    while (!pm_metal_async_session_root_done ()) {
      pm_metal_async_session_pump ();
      if (pm_metal_time_mono_us () >= deadline || ++spins > 500000u) {
        break;
      }

      /* No Boot Services Stall — that adds 1 ms wake latency per idle loop. */
      CpuPause ();
    }
  }

  if (pm_metal_async_session_root_done ()) {
    INT32  st;

    st = pm_metal_async_session_root_status ();
    pm_metal_async_session_end ();
    (VOID)name;
    (VOID)module;
    return (st == (INT32)PM_METAL_DONE) ? 0 : -1;
  }

  /* Keep session + instance alive for shell_poll. */
  mLiveModule = module;
  mLiveInst   = inst;
  mLiveEnv    = exec_env;
  AsciiStrnCpyS (mLiveName, sizeof (mLiveName),
                 name != NULL ? name : "mod", sizeof (mLiveName) - 1);
  pm_metal_lifecycle_set (
    PM_METAL_GFX_SURFACE_DEFAULT,
    PM_METAL_LIFE_FOCUSED | PM_METAL_LIFE_VISIBLE
    );
  /* Foreground tab + live session → guest keys (any mod). */
  pm_metal_ui_sync_input_focus ();
  return 0;
}

/**
 * Pump live session; if finished, tear down and return 1 with *status.
 * Returns 0 if still running / none; -1 on error finish.
 */
int
pm_metal_wasm_session_poll (
  INT32  *status_out
  )
{
  INT32  st;

  if (!pm_metal_async_session_active ()) {
    return 0;
  }

  pm_metal_async_session_pump ();
  if (!pm_metal_async_session_root_done ()) {
    return 0;
  }

  st = pm_metal_async_session_root_status ();
  if (status_out != NULL) {
    *status_out = st;
  }

  MetalWasmLiveFinish ();
  return (st == (INT32)PM_METAL_DONE) ? 1 : -1;
}

int
pm_metal_wasm_session_await (
  UINT32  max_ms
  )
{
  UINT64  t0;
  UINT64  deadline;
  INT32   st;

  if (!pm_metal_async_session_active ()) {
    return 0;
  }

  t0       = pm_metal_time_mono_us ();
  deadline = t0 + (UINT64)max_ms * 1000u;
  while (!pm_metal_async_session_root_done ()) {
    pm_metal_async_session_pump ();
    if (pm_metal_time_mono_us () >= deadline) {
      pm_metal_log ("metal-wasm: session await timed out");
      MetalWasmLiveFinish ();
      return -1;
    }

    /* Busy-pump on CPU0; timers wake via coro_poll inside run_poll. */
    CpuPause ();
  }

  st = pm_metal_async_session_root_status ();
  MetalWasmLiveFinish ();
  return (st == (INT32)PM_METAL_DONE) ? 0 : -1;
}

int
pm_metal_wasm_session_active (
  VOID
  )
{
  return pm_metal_async_session_active ();
}

CONST CHAR8 *
pm_metal_wasm_session_name (
  VOID
  )
{
  return mLiveName[0] != '\0' ? mLiveName : NULL;
}

int
pm_metal_wasm_run_bytes (
  CONST CHAR8   *name,
  CONST UINT8   *bytes,
  UINT32         len
  )
{
  wasm_module_t           module;
  wasm_module_inst_t      inst;
  wasm_exec_env_t         exec_env;
  wasm_function_inst_t    step_fn;
  CHAR8                   error_buf[128];
  CONST CHAR8            *argv[1];
  INT32                   argc;
  INT32                   ret;
  UINT8                  *copy;

  if (!mReady || bytes == NULL || len == 0) {
    return -1;
  }

  if (pm_metal_async_session_active ()) {
    pm_metal_log ("metal-wasm: session already active");
    return -1;
  }

  copy = (UINT8 *)pm_metal_mem_alloc (
                    len,
                    PM_METAL_MEM_HEAP,
                    PM_METAL_MEM_ID_NONE
                    );
  if (copy == NULL) {
    pm_metal_logf (
      "metal-wasm: copy %a failed (%u bytes)",
      name != NULL ? name : "?",
      len
      );
    return -1;
  }

  CopyMem (copy, bytes, len);
  pm_metal_logf ("metal-wasm: load begin %a", name != NULL ? name : "?");

  error_buf[0] = '\0';
  module       = wasm_runtime_load (
                   copy,
                   len,
                   error_buf,
                   sizeof (error_buf)
                   );
  if (module == NULL) {
    pm_metal_logf (
      "metal-wasm: load %a failed: %a",
      name != NULL ? name : "?",
      error_buf
      );
    pm_metal_mem_free (copy);
    return -1;
  }

  pm_metal_logf ("metal-wasm: load ok %a", name != NULL ? name : "?");

  argv[0] = (name != NULL) ? name : "mod";
  argc    = 1;
  /*
   * No WASI preopen — guests use Metal FS (awaitable). Guest packages will
   * need Metal ABI before re-enable; do not reintroduce "/" → ESP here.
   */
  wasm_runtime_set_wasi_args (
    module,
    NULL,
    0,
    NULL,
    0,
    NULL,
    0,
    (CHAR8 **)argv,
    argc
    );

  pm_metal_logf (
    "metal-wasm: instantiate %a stack=%u heap=%u",
    name != NULL ? name : "?",
    (UINT32)PM_METAL_WASM_STACK_SIZE,
    (UINT32)PM_METAL_WASM_HEAP_BYTES
    );
  error_buf[0] = '\0';
  inst         = wasm_runtime_instantiate (
                   module,
                   PM_METAL_WASM_STACK_SIZE,
                   PM_METAL_WASM_HEAP_BYTES,
                   error_buf,
                   sizeof (error_buf)
                   );
  if (inst == NULL) {
    pm_metal_logf (
      "metal-wasm: instantiate %a failed: %a",
      name != NULL ? name : "?",
      error_buf
      );
    wasm_runtime_unload (module);
    pm_metal_mem_free (copy);
    return -1;
  }

  pm_metal_logf ("metal-wasm: instantiate ok %a", name != NULL ? name : "?");

  step_fn = wasm_runtime_lookup_function (inst, "pm_metal_guest_step");
  if (step_fn != NULL) {
    exec_env = wasm_runtime_create_exec_env (inst, PM_METAL_WASM_STACK_SIZE);
    if (exec_env == NULL) {
      pm_metal_logf (
        "metal-wasm: async exec_env %a failed",
        name != NULL ? name : "?"
        );
      wasm_runtime_deinstantiate (inst);
      wasm_runtime_unload (module);
      pm_metal_mem_free (copy);
      return -1;
    }

    mLiveCopy = copy;
    pm_metal_fs_bind_inst (inst);
    pm_metal_blk_bind_inst (inst);
    pm_metal_audio_bind_inst (inst);
    pm_metal_input_bind_inst (inst);
    pm_metal_lifecycle_bind_inst (inst);
    pm_metal_stream_bind_inst (inst);
    pm_metal_net_bind_inst (inst);
    pm_metal_net_tls_bind_inst (inst);
    pm_metal_net_ping_bind_inst (inst);
    pm_metal_net_http_bind_inst (inst);
    pm_metal_random_bind_inst (inst);
    ret       = MetalWasmRunAsyncLive (name, module, inst, exec_env, step_fn);
    if (ret != 0 || !pm_metal_async_session_active ()) {
      /* Finished during startup or failed — drop ownership. */
      wasm_runtime_destroy_exec_env (exec_env);
      wasm_runtime_deinstantiate (inst);
      wasm_runtime_unload (module);
      pm_metal_mem_free (copy);
      mLiveCopy   = NULL;
      mLiveModule = NULL;
      mLiveInst   = NULL;
      mLiveEnv    = NULL;
    }

    return ret;
  }

  /* Sync mod — one-shot execute_main. */
  pm_metal_fs_bind_inst (inst);
  pm_metal_blk_bind_inst (inst);
  pm_metal_audio_bind_inst (inst);
  pm_metal_input_bind_inst (inst);
  pm_metal_lifecycle_bind_inst (inst);
  pm_metal_stream_bind_inst (inst);
  pm_metal_net_bind_inst (inst);
  pm_metal_net_tls_bind_inst (inst);
  pm_metal_net_ping_bind_inst (inst);
  pm_metal_net_http_bind_inst (inst);
  pm_metal_random_bind_inst (inst);
  ret = 0;
  if (!wasm_application_execute_main (inst, argc, (CHAR8 **)argv)) {
    CONST CHAR8  *exc;

    exc = wasm_runtime_get_exception (inst);
    pm_metal_logf (
      "metal-wasm: execute %a failed: %a",
      name != NULL ? name : "?",
      exc != NULL ? exc : "?"
      );
    ret = -1;
  } else {
    ret = (INT32)wasm_runtime_get_wasi_exit_code (inst);
  }

  wasm_runtime_deinstantiate (inst);
  wasm_runtime_unload (module);
  pm_metal_mem_free (copy);
  return ret;
}

int
pm_metal_wasm_run_mod (
  CONST CHAR8  *name
  )
{
  CONST UINT8  *bytes;
  UINT32        len;
  UINT8        *esp_bytes;
  UINT32        esp_len;
  CHAR8         path[96];
  INT32         rc;

  if (name == NULL) {
    return -1;
  }

  if (pm_metal_wasm_mod_lookup (name, &bytes, &len) == 0) {
    return pm_metal_wasm_run_bytes (name, bytes, len);
  }

  /* ESP package: mods/apps/<name>/<name>.wasm */
  AsciiSPrint (path, sizeof (path), "mods/apps/%a/%a.wasm", name, name);
  esp_bytes = NULL;
  esp_len   = 0;
  if (pm_metal_esp_ready ()
      && pm_metal_esp_read_file (path, &esp_bytes, &esp_len) == 0)
  {
    pm_metal_logf ("metal-wasm: esp %a (%u bytes)", path, esp_len);
    rc = pm_metal_wasm_run_bytes (name, esp_bytes, esp_len);
    pm_metal_logf (
      "metal-wasm: esp %a rc=%d live=%d",
      path,
      rc,
      pm_metal_async_session_active ()
      );
    pm_metal_mem_free (esp_bytes);
    return rc;
  }

  pm_metal_logf ("metal-wasm: unknown mod '%a'", name);
  return -1;
}
